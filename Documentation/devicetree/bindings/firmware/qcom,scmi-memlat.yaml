## Documentation/devicetree/bindings/firmware/qcom,scmi-memlat.yaml
```yaml
# SPDX-License-Identifier: (GPL-2.0 OR BSD-2-Clause)
%YAML 1.2
---
$id: http://devicetree.org/schemas/firmware/qcom,scmi-memlat.yaml#
$schema: http://devicetree.org/meta-schemas/core.yaml#

title: Qualcomm SCMI Memory Bus nodes

maintainers:
  - Sibi Sankar <quic_sibis@quicinc.com>

description:
  This binding describes the various memory buses that can be monitored and scaled
  by memory latency governor running on the CPU Control Processor (SCMI controller).

properties:
  protocol@80:
    $ref: '/schemas/firmware/arm,scmi.yaml#/$defs/protocol-node'
    unevaluatedProperties: false

    properties:
      reg:
        const: 0x80

    patternProperties:
      '^memory-[0-9]$':
        type: object
        unevaluatedProperties: false
        description:
          The list of all memory buses that can be monitored and scaled by the
          memory latency governor running on the SCMI controller.

        properties:
          qcom,memory-type:
            $ref: /schemas/types.yaml#/definitions/uint32
            enum: [0, 1, 2]
            description: |
              Memory Bus Identifier
              0 = QCOM_MEM_TYPE_DDR
              1 = QCOM_MEM_TYPE_LLCC
              2 = QCOM_MEM_TYPE_DDR_QOS

          freq-table-hz:
            items:
              items:
                - description: Minimum frequency of the memory bus in Hz
                - description: Maximum frequency of the memory bus in Hz

        patternProperties:
          '^monitor-[0-9]$':
            type: object
            unevaluatedProperties: false
            description:
              The list of all monitors detecting the memory latency bound workloads using
              various counters.

            properties:
              qcom,compute-type:
                description:
                  Monitors of type compute perform bus dvfs based on a rudimentary CPU
                  frequency to memory frequency map.
                type: boolean

              qcom,ipm-ceil:
                $ref: /schemas/types.yaml#/definitions/uint32
                description:
                  Monitors having this property perform bus dvfs based on the same
                  rudimentary table but the scaling is performed only if the calculated
                  IPM (Instruction Per Misses) exceeds the given ceiling.

              cpus:
                $ref: /schemas/types.yaml#/definitions/phandle-array
                description:
                  Should be a list of phandles to CPU nodes (as described in
                  Documentation/devicetree/bindings/arm/cpus.yaml).

              operating-points-v2: true
              opp-table:
                type: object

            required:
              - cpus
              - operating-points-v2

            oneOf:
              - required: [ 'qcom,compute-type' ]
              - required: [ 'qcom,ipm-ceil' ]

        required:
          - qcom,memory-type
          - freq-table-hz

additionalProperties: true

examples:
  - |
    #include <dt-bindings/firmware/qcom,scmi-memlat.h>

    firmware {
        scmi {
            compatible = "arm,scmi";
            mboxes = <&cpucp_mbox 0>, <&cpucp_mbox 2>;
            mbox-names = "tx", "rx";
            shmem = <&cpu_scp_lpri0>, <&cpu_scp_lpri1>;

            #address-cells = <1>;
            #size-cells = <0>;

            protocol@80 {
                reg = <0x80>;

                memory-0 {
                    qcom,memory-type = <QCOM_MEM_TYPE_DDR>;
                    freq-table-hz = /bits/ 64 <200000000 4224000000>;

                    monitor-0 {
                        qcom,ipm-ceil = <20000000>;
                        cpus = <&CPU0 &CPU1 &CPU2 &CPU3 &CPU4 &CPU5 &CPU6 &CPU7
                                &CPU8 &CPU9 &CPU10 &CPU11>;
                        operating-points-v2 = <&memory0_monitor0_opp_table>;

                        memory0_monitor0_opp_table: opp-table {
                            compatible = "operating-points-v2";

                            opp-999000000 {
                                opp-hz = /bits/ 64 <999000000 547000000>;
                            };

                            opp-1440000000 {
                                opp-hz = /bits/ 64 <1440000000 768000000>;
                            };

                            opp-1671000000 {
                                opp-hz = /bits/ 64 <1671000000 1555000000>;
                            };

                            opp-2189000000 {
                                opp-hz = /bits/ 64 <2189000000 2092000000>;
                            };

                            opp-2516000000 {
                                opp-hz = /bits/ 64 <2516000000 3187000000>;
                            };

                            opp-3860000000 {
                                opp-hz = /bits/ 64 <3860000000 4224000000>;
                            };
                        };
                    };

                    monitor-1 {
                        qcom,compute-type;
                        cpus = <&CPU0 &CPU1 &CPU2 &CPU3 &CPU4 &CPU5 &CPU6 &CPU7
                                &CPU8 &CPU9 &CPU10 &CPU11>;
                        operating-points-v2 = <&memory0_monitor1_opp_table>;

                        memory0_monitor1_opp_table: opp-table {
                            compatible = "operating-points-v2";

                            opp-1440000000 {
                                    opp-hz = /bits/ 64 <1440000000 200000000>;
                            };

                            opp-2189000000 {
                                    opp-hz = /bits/ 64 <2189000000 768000000>;
                            };

                            opp-2516000000 {
                                    opp-hz = /bits/ 64 <2516000000 1555000000>;
                            };

                            opp-3860000000 {
                                    opp-hz = /bits/ 64 <3860000000 4224000000>;
                            };
                        };
                    };
                };

                memory-1 {
                    qcom,memory-type = <QCOM_MEM_TYPE_LLCC>;
                    freq-table-hz = /bits/ 64 <300000000 1067000000>;

                    monitor-0 {
                        qcom,ipm-ceil = <20000000>;
                        cpus = <&CPU0 &CPU1 &CPU2 &CPU3 &CPU4 &CPU5 &CPU6 &CPU7
                                &CPU8 &CPU9 &CPU10 &CPU11>;
                        operating-points-v2 = <&memory1_monitor0_opp_table>;

                        memory1_monitor0_opp_table: opp-table {
                            compatible = "operating-points-v2";

                            opp-999000000 {
                                opp-hz = /bits/ 64 <999000000 300000000>;
                            };

                            opp-1440000000 {
                                opp-hz = /bits/ 64 <1440000000 466000000>;
                            };

                            opp-1671000000 {
                                opp-hz = /bits/ 64 <1671000000 600000000>;
                            };

                            opp-2189000000 {
                                opp-hz = /bits/ 64 <2189000000 806000000>;
                            };

                            opp-2516000000 {
                                opp-hz = /bits/ 64 <2516000000 933000000>;
                            };

                            opp-3860000000 {
                                opp-hz = /bits/ 64 <3860000000 1066000000>;
                            };
                        };
                    };
                };

                memory-2 {
                    qcom,memory-type = <QCOM_MEM_TYPE_DDR_QOS>;
                    freq-table-hz = /bits/ 64 <QCOM_DDR_LEVEL_AUTO QCOM_DDR_LEVEL_PERF>;

                    monitor-0 {
                        qcom,ipm-ceil = <20000000>;
                        cpus = <&CPU0 &CPU1 &CPU2 &CPU3 &CPU4 &CPU5 &CPU6 &CPU7
                                &CPU8 &CPU9 &CPU10 &CPU11>;
                        operating-points-v2 = <&memory2_monitor0_opp_table>;

                        memory2_monitor0_opp_table: opp-table {
                            compatible = "operating-points-v2";

                            opp-2189000000 {
                                opp-hz = /bits/ 64 <2189000000>;
                                opp-level = <QCOM_DDR_LEVEL_AUTO>;
                            };

                            opp-3860000000 {
                                opp-hz = /bits/ 64 <3860000000>;
                                opp-level = <QCOM_DDR_LEVEL_PERF>;
                            };
                        };
                    };
                };
            };
        };
    };
```

## arch/riscv/boot/image-dual-core.its
```
/dts-v1/;

/ {
    description = "U-Boot fitImage for riscv64 kernel";
    #address-cells = <1>;

    images {
        kernel {
            description = "Linux Kernel";
            data = /incbin/("./Image");
            type = "kernel";
            arch = "riscv";
            os = "linux";
            compression = "none";
            load = <0x82000000>;
            entry = <0x82000000>;
        };
        fdt {
            description = "Flattened Device Tree blob";
            data = /incbin/("./dts/rocket-chip-vcu128/rocket-chip-vcu128-dual-core.dtb");
            type = "flat_dt";
            arch = "riscv";
            compression = "none";
        };
        ramdisk {
            description = "Initramfs";
            data = /incbin/("../../../../buildroot/output/images/rootfs.cpio");
            type = "ramdisk";
            arch = "riscv";
            os = "linux";
            compression = "none";
        };
    };
    configurations {
        default = "conf";
        conf {
            description = "Boot Linux kernel with FDT blob and initramfs";
            kernel = "kernel";
            fdt = "fdt";
            ramdisk = "ramdisk";
        };
    };
};
```

## arch/riscv/boot/image.its
```
/dts-v1/;

/ {
    description = "U-Boot fitImage for riscv64 kernel";
    #address-cells = <1>;

    images {
        kernel {
            description = "Linux Kernel";
            data = /incbin/("./Image");
            type = "kernel";
            arch = "riscv";
            os = "linux";
            compression = "none";
            load = <0x80200000>;
            entry = <0x80200000>;
        };
        fdt {
            description = "Flattened Device Tree blob";
            data = /incbin/("./dts/rocket-chip-vcu128/rocket-chip-vcu128.dtb");
            type = "flat_dt";
            arch = "riscv";
            compression = "none";
        };
    };
    configurations {
        default = "conf";
        conf {
            description = "Boot Linux kernel with FDT blob";
            kernel = "kernel";
            fdt = "fdt";
        };
    };
};
```

## arch/riscv/configs/rocket-chip-vcu128_defconfig
```kconfig
# arch config
CONFIG_64BIT=y
CONFIG_RISCV=y
CONFIG_MMU=y
CONFIG_SMP=y
CONFIG_SOC_ROCKET_CHIP_VCU128=y

# serial
CONFIG_SERIAL_8250=y
CONFIG_SERIAL_8250_CONSOLE=y
CONFIG_SERIAL_OF_PLATFORM=y
CONFIG_HVC_RISCV_SBI=y

# init ramdisk
CONFIG_BLK_DEV_INITRD=y

# dev tmpfs
CONFIG_DEVTMPFS=y
CONFIG_DEVTMPFS_MOUNT=y

# useful fs
CONFIG_PROC_FS=y
CONFIG_SYSFS=y
CONFIG_TMPFS=y

# network
CONFIG_NET=y
CONFIG_NETDEVICES=y
CONFIG_ETHERNET=y
CONFIG_NET_VENDOR_XILINX=y
CONFIG_XILINX_AXI_EMAC=y
CONFIG_DP83867_PHY=y
CONFIG_INET=y
CONFIG_PACKET=y
CONFIG_IP_ADVANCED_ROUTER=y
CONFIG_IP_MULTIPLE_TABLES=y
CONFIG_UNIX=y

# i2c
CONFIG_I2C=y
CONFIG_I2C_XILINX=y

# gpio
CONFIG_GPIOLIB=y
CONFIG_GPIO_PCA953X=y
CONFIG_GPIO_SYSFS=y

# spi
CONFIG_SPI=y
CONFIG_SPI_XILINX=y

# mtd
CONFIG_MTD=y
CONFIG_MTD_SPI_NOR=y
CONFIG_MTD_BLOCK=y
CONFIG_MTD_BLOCK_RO=y
CONFIG_JFFS2_FS=y

# others
CONFIG_PRINTK_TIME=y
CONFIG_EMBEDDED=y

# reduce size
CONFIG_CC_OPTIMIZE_FOR_SIZE=y
CONFIG_COREDUMP=n
CONFIG_DIRECTIO=n
CONFIG_EFI=n
CONFIG_SWAP=n
CONFIG_USB_SUPPORT=n
CONFIG_HID=n
CONFIG_VGA_CONSOLE=n
CONFIG_HWMON=n
CONFIG_HW_RANDOM=n
CONFIG_INPUT_MOUSE=n
CONFIG_EFI_PARTITION=n
```
